## arch/arm/mach-k3/am62lx/Kconfig
```kconfig
# SPDX-License-Identifier: GPL-2.0+
#
# Copyright (C) 2025 Texas Instruments Incorporated - https://www.ti.com/
#

if SOC_K3_AM62L3

choice
	prompt "TI K3 AM62Lx based boards"
	optional

config TARGET_AM62L3_EVM
	bool "TI K3 based AM62L5 EVM"
	select ARM64
	select BINMAN
	select OF_UPSTREAM
	select OF_SYSTEM_SETUP

config TARGET_MYC_YM62LX
	bool "MYIR based MYC_YM62LX"
	select ARM64
	select BINMAN
	select OF_UPSTREAM
	select OF_SYSTEM_SETUP

endchoice

source "board/ti/am62lx/Kconfig"
source "board/myir/myc_ym62lx/Kconfig"

endif
```

## board/myir/myc_am62x/Kconfig
```kconfig
# SPDX-License-Identifier: GPL-2.0+
#
# Copyright (C) 2020-2022 Texas Instruments Incorporated - https://www.ti.com/
#	Suman Anna <s-anna@ti.com>

if TARGET_MYC_AM62X_A53

config SYS_BOARD
       default "myc_am62x"

config SYS_VENDOR
       default "myir"

config SYS_CONFIG_NAME
       default "myc_am62x"

source "board/myir/common/Kconfig"

endif

if TARGET_MYC_AM62X_R5

config SYS_BOARD
       default "myc_am62x"

config SYS_VENDOR
       default "myir"

config SYS_CONFIG_NAME
       default "myc_am62x"

config SPL_LDSCRIPT
	default "arch/arm/mach-omap2/u-boot-spl.lds"

source "board/myir/common/Kconfig"

endif
```

## board/myir/myc_ym62lx/Kconfig
```kconfig
# SPDX-License-Identifier: GPL-2.0+
#
# Copyright (C) 2025 Texas Instruments Incorporated - https://www.ti.com/
#

if TARGET_MYC_YM62LX

config SYS_BOARD
       default "myc_ym62lx"

config SYS_VENDOR
       default "myir"

config SYS_CONFIG_NAME
       default "myc_ym62lx"

source "board/myir/common/Kconfig"

endif
```
