// SPDX-License-Identifier: GPL-2.0
/*
 * Copyright (C) 2024 Texas Instruments Incorporated - https://www.ti.com/
 */

#include "myd-ym62lx-nand-binman.dtsi"

/ {
	aliases {
		mmc1 = &sdhci1;
	};
};

&scmi {
	bootph-all;
};
