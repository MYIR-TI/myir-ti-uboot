// SPDX-License-Identifier: GPL-2.0
/*
 * AM625 SK dts file for R5 SPL
 * Copyright (C) 2021-2022 Texas Instruments Incorporated - https://www.ti.com/
 */

#include "myd-am62x.dts"
#include "myd-am62x-ddr4-1600MTs.dtsi"
#include "myd-am62x-ddr.dtsi"

#include "myd-am62x-u-boot.dtsi"
#include "myd-am62x-r5-common.dtsi"

&main_pktdma {
	ti,sci = <&dm_tifs>;
	bootph-all;
};
